## drivers/xiaomi/Kconfig
```kconfig
# SPDX-License-Identifier: GPL-2.0-only

menu "Xiaomi drivers"

source "drivers/xiaomi/boottime/Kconfig"

source "drivers/xiaomi/millet/Kconfig"

endmenu
```

## drivers/xiaomi/boottime/Kconfig
```kconfig
# SPDX-License-Identifier: GPL-2.0-only
#
# Mi boot time
#

config MI_BOOT_TIME
	tristate "boot time record"
	default n
	help
	This adds support for mi boot time. As a module the initcall
	tracepoints have already fired before modprobe, so only the
	/proc/bootprof write interface stays useful; say y to capture
	kernel initcall timings.
```

## drivers/xiaomi/millet/Kconfig
```kconfig
# SPDX-License-Identifier: GPL-2.0-only

config MILLET
	tristate "Sew millet: smart frozen control subsystem (dada OS4 port)"
	default n
	help
	  Port of the Xiaomi dada OS4 millet freeze chain: millet_core
	  (hook-slot bus types 1..6 + uid hash tables + netlink unit 31
	  server with the OS4 tier/cmd protocol + /proc/millet nodes) plus
	  the sig (type 1 signal sniffer), hs (type 6 handshake), pkg
	  (type 5 netfilter sniffer, exports find_and_clear_piduid) and
	  oem_cgroup (freezer can_attach gatekeeper) sensors. Includes a
	  binder-freeze preemption observer re-implemented on the public
	  android_vh_binder hooks with the in-tree frozen() predicate
	  (the closed binder_gki exports cannot be ported).  All switches
	  default off (millet_freeze_switch=0).  Module-only (needs
	  vendor-conflict review before any built-in): do NOT set =y
	  while the vendor millet ko may still load.
```

## features/07-xiaomi-unionpower/drivers/mihw/Kconfig
```kconfig
# SPDX-License-Identifier: GPL-2.0-only
#
# Xiaomi MI hardware/power helpers (built-in port)
#

config MI_UNION_POWER
	bool "MI UnionPower core: frame load / jank monitor"
	default y
	help
	  Port of Xiaomi's unionpower frame load and jank monitoring engine.
	  Receives frame queue/vsync events from the compositor via
	  /proc/unionpower/ioctl, tracks per-process frame intervals and flags
	  jank. Exposes /sys/.../unionpower/frame_jank. Requires the
	  SurfaceFlinger/compositor side to report frame events to be useful;
	  without reporting it is inert.
```

## features/15-xiaomi-boottime/drivers/xiaomi/Kconfig
```kconfig
# SPDX-License-Identifier: GPL-2.0-only

menu "Xiaomi drivers"

source "drivers/xiaomi/boottime/Kconfig"

endmenu
```

## kernel/sched/xiaomi_sched/qcom/mi_game/Kconfig
```kconfig
# SPDX-License-Identifier: GPL-2.0-only
config MI_GAME
	tristate "Sew OS4 mi_game game sched accelerator (stage-1 skeleton)"
	depends on ARM64 && PLAT_COMMON && ANDROID_VENDOR_HOOKS && UCLAMP_TASK
	default n
	help
	  Stage-1 skeleton port of Xiaomi dada OS4 mi_game.ko
	  (migt-driver/game-load/FLT game scheduling accelerator).
	  Provides /dev/migt + ioctl dispatch skeleton, proc triple
	  tree, 17 plat_common providers and 4 RVH probes. Game-load
	  (stage 2), FLT/PELT (stage 3) and vip/arbitration policy
	  (stage 4) bodies plug in later. Keep =m for hot iteration
	  (rmmod/insmod threshold tuning); do not set =y before the
	  DDR/online stubs of stage 4 are resolved.
```

## mm/damon/Kconfig
```kconfig
# SPDX-License-Identifier: GPL-2.0-only

menu "Data Access Monitoring"

config DAMON
	bool "DAMON: Data Access Monitoring Framework"
	help
	  This builds a framework that allows kernel subsystems to monitor
	  access frequency of each memory region. The information can be useful
	  for performance-centric DRAM level memory management.

	  See https://damonitor.github.io/doc/html/latest-damon/index.html for
	  more information.

config DAMON_KUNIT_TEST
	bool "Test for damon" if !KUNIT_ALL_TESTS
	depends on DAMON && KUNIT=y
	default KUNIT_ALL_TESTS
	help
	  This builds the DAMON Kunit test suite.

	  For more information on KUnit and unit tests in general, please refer
	  to the KUnit documentation.

	  If unsure, say N.

config DAMON_VADDR
	bool "Data access monitoring primitives for virtual address spaces"
	depends on DAMON && MMU
	select PAGE_IDLE_FLAG
	help
	  This builds the default data access monitoring primitives for DAMON
	  that work for virtual address spaces.

config MI_DAMON
	tristate "mi_damon: Xiaomi cold-page reclaim on DAMON vaddr (direct port)"
	depends on DAMON_VADDR
	default n
	help
	  Direct port of Xiaomi mi_damon.ko (dada OS4, kernel 6.6.57,
	  virtual-address cold-page reclaim) onto the 5.15 in-tree DAMON
	  core + vaddr primitive.  VMA traversal is delegated to
	  mm/damon/vaddr.c (rbtree find_vma, no maple tree).  Exposes
	  /sys/kernel/mi_damon and the mi_damon:damon_aggregated tracepoint
	  for BPF consumers.  Experimental residual-port item; default n.

config DAMON_PADDR
	bool "Data access monitoring primitives for the physical address space"
	depends on DAMON && MMU
	select PAGE_IDLE_FLAG
	help
	  This builds the default data access monitoring primitives for DAMON
	  that works for the physical address space.

config DAMON_VADDR_KUNIT_TEST
	bool "Test for DAMON primitives" if !KUNIT_ALL_TESTS
	depends on DAMON_VADDR && KUNIT=y
	default KUNIT_ALL_TESTS
	help
	  This builds the DAMON virtual addresses primitives Kunit test suite.

	  For more information on KUnit and unit tests in general, please refer
	  to the KUnit documentation.

	  If unsure, say N.

config DAMON_DBGFS
	bool "DAMON debugfs interface"
	depends on DAMON_VADDR && DAMON_PADDR && DEBUG_FS
	help
	  This builds the debugfs interface for DAMON.  The user space admins
	  can use the interface for arbitrary data access monitoring.

	  If unsure, say N.

config DAMON_DBGFS_KUNIT_TEST
	bool "Test for damon debugfs interface" if !KUNIT_ALL_TESTS
	depends on DAMON_DBGFS && KUNIT=y
	default KUNIT_ALL_TESTS
	help
	  This builds the DAMON debugfs interface Kunit test suite.

	  For more information on KUnit and unit tests in general, please refer
	  to the KUnit documentation.

	  If unsure, say N.

config DAMON_RECLAIM
	bool "Build DAMON-based reclaim (DAMON_RECLAIM)"
	depends on DAMON_PADDR
	help
	  This builds the DAMON-based reclamation subsystem.  It finds pages
	  that not accessed for a long time (cold) using DAMON and reclaim
	  those.

	  This is suggested to be used as a proactive and lightweight
	  reclamation under light memory pressure, while the traditional page
	  scanning-based reclamation is used for heavy pressure.

endmenu
```
